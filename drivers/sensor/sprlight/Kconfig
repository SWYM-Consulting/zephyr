## drivers/sensor/sprlight/Kconfig
```kconfig
config SPRLIGHT_SENSOR
	bool "SWYM Photoresistive Light Sensor"
	depends on ADC
	help
	  Enable driver for SWYM light sensor.
```

## drivers/sensor/zoe_m8q/Kconfig
```kconfig
#/******************************************************************************
# *
# * @file            Kconfig
# *
# * @brief           Kconfig ZOE-M8Q GPS device configuration options
# *
# * @details         Using Zephyr icm42605 Kconfig as a template
# * 
# * @author(s)       Marshall Wingerson
# *
# * @created         05/31/2021   (MM/DD/YYYY)
# *
# * @copyright       © 2020 SWYM, LLC. All Rights Reserved.
# *
# *****************************************************************************/


# FIXME - change to ZOE-M8Q settings



menuconfig ZOEM8Q
	bool "U-Blox ZOE-M8Q 72-channel GNSS Reciever"
	depends on SPI
	help
	  Enable driver for U-Blox ZOE-M8Q 72-channel GNSS Reciever.
```

## drivers/sound/Kconfig
```kconfig
menuconfig SOUND
	bool "Sound Drivers"
	help
	  Include sound drivers in system config

if sound
source "drivers/sound/tlv320/Kconfig"

endif
```

## drivers/sound/tlv320/Kconfig
```kconfig
menuconfig TLV320
	bool "TLV320 Codec"
	depends on I2C
	help
	  Enable driver for TLV320 Codec
```

## dts/bindings/sensor/swym,sprlight.yaml
```yaml
# Copyright (c) 2019 Nordic Semiconductor ASA
# SPDX-License-Identifier: Apache-2.0

description: SWYM Photoresistive Light Sensor

compatible: "swym,sprlight"

include: base.yaml

properties:
  label:
    required: true
```

## dts/bindings/sensor/u-blox,zoe-m8q.yaml
```yaml
# /******************************************************************************
# *
# * @file            u-blox,zoem8q.yaml
# *
# * @brief           Binding for u-blox ZOE-M8Q
# *
# * @details         Using Zephyr icm42605.yaml as a template
# * 
# * @author(s)       Marshall Wingerson
# *
# * @created         05/31/2021   (MM/DD/YYYY)
# *
# *****************************************************************************/

description: U-Blox ZOE-M8Q GPS

compatible: "u-blox,zoe-m8q"

include: spi-device.yaml

properties:
    int-gpios:
      type: phandle-array
      required: false
      description: |
        UNUSED - External interrupt pin for low-power mode. Active LOW. Not enabled by default

    time-pulse-gpios:
      type: phandle-array
      required: false
      description: |
        UNUSED - Pulse per second pin. Active LOW. Not enabled by default

    reset-gpios:
      type: phandle-array
      required: true
      description: |
        UNUSED - Reset pin. Active LOW. 
```
